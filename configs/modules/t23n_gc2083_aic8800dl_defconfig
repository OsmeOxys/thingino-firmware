## configs/modules/t23n_gc2083_aic8800dl_defconfig
```kconfig
# NAME: T23N, GC2083, AIC8800
# FRAG: soc toolchain ccache brand rootfs kernel system target uboot
BR2_SENSOR_GC2083=y
BR2_SOC_INGENIC_T23N=y
BR2_PACKAGE_THINGINO_KOPT_DWC2=y
BR2_PACKAGE_THINGINO_KOPT_DWC2_WIFI_ONLY=y
BR2_PACKAGE_WIFI=y
BR2_PACKAGE_WIFI_AIC8800=y
```
